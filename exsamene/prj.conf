## CMakeLists.txt
```
# SPDX-License-Identifier: Apache-2.0

cmake_minimum_required(VERSION 3.20.0)
find_package(Zephyr REQUIRED HINTS $ENV{ZEPHYR_BASE})
project(blinky)

target_sources(app PRIVATE
        src/main.c
        src/rgb_lcd.c
        src/screen.c
        src/tem_hum.c
        src/network_config.c
        src/alarm.c
        src/networking_config_news.c
        src/wifi_connect.c
        )
```

## prj.conf
```kconfig
CONFIG_GPIO=y
CONFIG_SERIAL=y
CONFIG_CONSOLE=y
CONFIG_UART_CONSOLE=y
CONFIG_STDOUT_CONSOLE=y
CONFIG_NEWLIB_LIBC=y
CONFIG_I2C=y
CONFIG_SPI=y
CONFIG_SENSOR=y

# Watchdog / RTC
CONFIG_WATCHDOG=y
CONFIG_WDT_DISABLE_AT_BOOT=y
CONFIG_RTC=y

# Heap
CONFIG_HEAP_MEM_POOL_SIZE=16384
CONFIG_NEWLIB_LIBC_MIN_REQUIRED_HEAP_SIZE=4096

# Threading
CONFIG_PRINTK=y
CONFIG_ASSERT=y
CONFIG_MAIN_STACK_SIZE=4096

# JSON
CONFIG_JSON_LIBRARY=y


# Networking core
CONFIG_NETWORKING=y
CONFIG_NET_IPV4=y
CONFIG_NET_IPV6=n
CONFIG_NET_DHCPV4=y
CONFIG_NET_TCP=y
CONFIG_NET_SOCKETS=y
CONFIG_NET_SOCKETS_OFFLOAD=y
CONFIG_POSIX_API=y
CONFIG_DNS_RESOLVER=n
CONFIG_DNS_RESOLVER_MAX_SERVERS=2
CONFIG_HTTP_CLIENT=y

# WiFi
CONFIG_WIFI=y
CONFIG_WIFI_ESWIFI=y
CONFIG_NET_L2_WIFI_MGMT=y
CONFIG_NET_MGMT=y
CONFIG_NET_MGMT_EVENT=y
CONFIG_NET_MGMT_EVENT_INFO=y

# Network buffers
CONFIG_NET_PKT_RX_COUNT=16
CONFIG_NET_BUF_RX_COUNT=16
CONFIG_NET_PKT_TX_COUNT=16
CONFIG_NET_BUF_TX_COUNT=16
CONFIG_NET_TX_STACK_SIZE=4096
CONFIG_NET_RX_STACK_SIZE=4096
CONFIG_NET_BUF_DATA_SIZE=256

# Logging
CONFIG_LOG=y
CONFIG_LOG_DEFAULT_LEVEL=3
CONFIG_LOG_PROCESS_THREAD=y
CONFIG_LOG_PROCESS_THREAD_STACK_SIZE=1024

# Force immediate/synchronous output instead of deferred
CONFIG_LOG_MODE_IMMEDIATE=y

# Make sure UART backend is active
CONFIG_LOG_BACKEND_UART=y
CONFIG_LOG_BACKEND_UART_OUTPUT_TEXT=y

# printk also goes to UART
CONFIG_PRINTK=y

CONFIG_WIFI_LOG_LEVEL_INF=y
CONFIG_NET_LOG=n


CONFIG_LOG_MODE_MINIMAL=y
CONFIG_LOG_BUFFER_SIZE=512
```

## src/main.c
```c
#include "zephyr/posix/sys/stat.h"
#include <zephyr/device.h>
#include <zephyr/drivers/adc.h>
#include <zephyr/kernel.h>
#include <zephyr/sys/printk.h>
#include <zephyr/drivers/gpio.h>
#include <zephyr/drivers/sensor.h>
#include <stdio.h>
#include <zephyr/sys/__assert.h>
#include "alarm.h"
#include "rgb_lcd.h"
#include "screen.h"
#include "tem_hum.h"
#include "network_config.h"

// ================================
// Stack sizes and priorities
// ================================
#define STACKSIZE           1024
#define STACKSIZE_NETWORK   3072   /* news thread parses a 5 KB buffer — give it room */
#define STACKSIZE_SCREEN    2048
#define STACKSIZE_ALARM     2048
#define PRIORITY_HIGH       3
#define PRIORITY            2
#define PRIORITY_min        1
#define START_FIRST_REQEST  0
#define START_SECOND_REQEST 0

// ================================
// Thread stacks
// ================================
K_THREAD_STACK_DEFINE(stack_1,     STACKSIZE_SCREEN);
K_THREAD_STACK_DEFINE(stack_2,     STACKSIZE);
K_THREAD_STACK_DEFINE(alarm_stack, STACKSIZE_ALARM);

// ================================
// Thread structs
// ================================
struct k_thread t1, t2;
struct k_thread alarm_thread;

// ================================
// WiFi + network threads
// ================================

K_THREAD_DEFINE(t_wifi,     STACKSIZE_NETWORK, wifi_connect,
                NULL, NULL, NULL, 1,        0, 0);
K_THREAD_DEFINE(t_info_web, STACKSIZE_NETWORK, network_config_thread_entry,
                NULL, NULL, NULL, PRIORITY, 0, START_FIRST_REQEST);
K_THREAD_DEFINE(t_news_web, STACKSIZE_NETWORK, network_config_thread_entry_news,
                NULL, NULL, NULL, PRIORITY, 0, START_SECOND_REQEST);

// ================================
// Temperature / humidity thread
// ================================
void temp_hum_thread_entry(void *arg1, void *arg2, void *arg3)
{
    ARG_UNUSED(arg1);
    ARG_UNUSED(arg2);
    ARG_UNUSED(arg3);
    tem_hum_init();
    while (1) {
        tem_hum_update();
        k_sleep(K_SECONDS(2));
    }
}

// ================================
// Main
// ================================
int main(void)
{
    /* Screen thread — boot splash + info loop */
    k_thread_create(&t1, stack_1, STACKSIZE_SCREEN,
                    screen_thread_entry, NULL, NULL, NULL,
                    PRIORITY, 0, K_NO_WAIT);

    /* Alarm thread (spawns its own speaker sub-thread internally) */
    k_thread_create(&alarm_thread, alarm_stack, STACKSIZE_ALARM,
                    alarm_thread_entry, NULL, NULL, NULL,
                    PRIORITY_HIGH, 0, K_NO_WAIT);

    /* Temperature / humidity thread */
    k_thread_create(&t2, stack_2, STACKSIZE,
                    temp_hum_thread_entry, NULL, NULL, NULL,
                    PRIORITY, 0, K_NO_WAIT);

    return 0;
}
```

## src/alarm.c
```c
#include "alarm.h"

#include <stdio.h>
#include <stdbool.h>
#include <zephyr/kernel.h>
#include <zephyr/sys/printk.h>
#include <zephyr/drivers/gpio.h>

// ================================
// Alarm configuration
// ================================

// 20 for testing. Change to 600 before final delivery.
#define ALARM_AUTO_MUTE_SECONDS 20
#define SNOOZE_SECONDS 300

#define DEFAULT_ALARM_HOUR   0
#define DEFAULT_ALARM_MINUTE 0
#define DEFAULT_ALARM_SECOND 3

// ================================
// GPIO pins
// ================================

#define SNOOZE_PIN   6   // PA6 / D12
#define MUTE_PIN     7   // PA7 / D11
#define ENABLE_PIN   1   // PB1 / D6
#define SPEAKER_PIN  0   // PB0 / D3

// ================================
// Clock state
// ================================

static int current_hour   = 0;
static int current_minute = 0;
static int current_second = 0;

// ================================
// Alarm state
// ================================

static int  alarm_hour   = DEFAULT_ALARM_HOUR;
static int  alarm_minute = DEFAULT_ALARM_MINUTE;
static int  alarm_second = DEFAULT_ALARM_SECOND;

static bool alarm_enabled  = true;
static bool alarm_active   = false;
static bool alarm_snoozed  = false;

static int active_seconds      = 0;
static int snooze_seconds_left = 0;

// ================================
// GPIO state
// ================================

static const struct device *gpioa;
static const struct device *gpiob;

static int last_snooze = 1;
static int last_mute   = 1;
static int last_enable = 1;

// ================================
// Clock update
// ================================

static void update_clock(void)
{
    current_second++;
    if (current_second >= 60) { current_second = 0; current_minute++; }
    if (current_minute >= 60) { current_minute = 0; current_hour++;   }
    if (current_hour   >= 24) { current_hour   = 0;                   }
}

// ================================
// Alarm check
// ================================

static void check_alarm_time(void)
{
    if (!alarm_enabled || alarm_active || alarm_snoozed) return;

    if (current_hour   == alarm_hour   &&
        current_minute == alarm_minute &&
        current_second == alarm_second) {
        alarm_active   = true;
        active_seconds = 0;
        printk("ALARM ACTIVE!\n");
    }
}

// ================================
// Snooze update
// ================================

static void update_snooze(void)
{
    if (!alarm_snoozed) return;
    snooze_seconds_left--;
    if (snooze_seconds_left <= 0) {
        alarm_snoozed  = false;
        alarm_active   = true;
        active_seconds = 0;
        printk("SNOOZE FINISHED - ALARM ACTIVE AGAIN!\n");
    }
}

// ================================
// Auto mute
// ================================

static void update_auto_mute(void)
{
    if (!alarm_active) return;
    active_seconds++;
    if (active_seconds >= ALARM_AUTO_MUTE_SECONDS) {
        alarm_active   = false;
        active_seconds = 0;
        printk("ALARM AUTO MUTED\n");
    }
}

// ================================
// Speaker thread
// ================================

/*
 * Runs in its own thread so the busy-toggle loop never overflows
 * the alarm thread's stack or blocks it for 100 ms at a time.
 */

#define SPEAKER_STACK_SIZE 512
#define SPEAKER_PRIORITY   4

K_THREAD_STACK_DEFINE(speaker_stack, SPEAKER_STACK_SIZE);
static struct k_thread speaker_thread_data;

static void speaker_thread_entry(void *arg1, void *arg2, void *arg3)
{
    ARG_UNUSED(arg1);
    ARG_UNUSED(arg2);
    ARG_UNUSED(arg3);

    while (1) {
        if (alarm_active && gpiob != NULL) {
            /* 200 half-cycles at 250 µs each ≈ one 100 ms beep burst */
            for (int i = 0; i < 200; i++) {
                gpio_pin_set(gpiob, SPEAKER_PIN, 1);
                k_busy_wait(250);
                gpio_pin_set(gpiob, SPEAKER_PIN, 0);
                k_busy_wait(250);
            }
            k_msleep(50);   /* short gap between bursts */
        } else {
            if (gpiob != NULL) {
                gpio_pin_set(gpiob, SPEAKER_PIN, 0);
            }
            k_msleep(100);
        }
    }
}

// ================================
// GPIO init
// ================================

void alarm_gpio_init(void)
{
    gpioa = DEVICE_DT_GET(DT_NODELABEL(gpioa));
    gpiob = DEVICE_DT_GET(DT_NODELABEL(gpiob));

    if (!device_is_ready(gpioa) || !device_is_ready(gpiob)) {
        printk("GPIO not ready\n");
        return;
    }

    gpio_pin_configure(gpioa, SNOOZE_PIN,  GPIO_INPUT | GPIO_PULL_UP);
    gpio_pin_configure(gpioa, MUTE_PIN,    GPIO_INPUT | GPIO_PULL_UP);
    gpio_pin_configure(gpiob, ENABLE_PIN,  GPIO_INPUT | GPIO_PULL_UP);
    gpio_pin_configure(gpiob, SPEAKER_PIN, GPIO_OUTPUT_INACTIVE);

    printk("Alarm GPIO ready\n");

    k_thread_create(&speaker_thread_data,
                    speaker_stack, SPEAKER_STACK_SIZE,
                    speaker_thread_entry,
                    NULL, NULL, NULL,
                    SPEAKER_PRIORITY, 0, K_NO_WAIT);
}

// ================================
// Button check
// ================================

void alarm_check_buttons(void)
{
    if (gpioa == NULL || gpiob == NULL) return;

    int snooze_now = gpio_pin_get(gpioa, SNOOZE_PIN);
    int mute_now   = gpio_pin_get(gpioa, MUTE_PIN);
    int enable_now = gpio_pin_get(gpiob, ENABLE_PIN);

    if (snooze_now == 0 && last_snooze == 1) alarm_snooze();
    if (mute_now   == 0 && last_mute   == 1) alarm_mute();
    if (enable_now == 0 && last_enable == 1) alarm_toggle_enabled();

    last_snooze = snooze_now;
    last_mute   = mute_now;
    last_enable = enable_now;
}

// ================================
// Alarm thread
// ================================

void alarm_thread_entry(void *arg1, void *arg2, void *arg3)
{
    ARG_UNUSED(arg1);
    ARG_UNUSED(arg2);
    ARG_UNUSED(arg3);

    printk("Alarm thread started\n");

    alarm_gpio_init();

    while (1) {
        update_clock();
        alarm_check_buttons();
        check_alarm_time();
        update_snooze();
        update_auto_mute();
        /* Speaker handled by its own thread */

        printk("Clock: %02d:%02d:%02d | Alarm: %02d:%02d | Enabled: %d | Active: %d | Snoozed: %d\n",
               current_hour, current_minute, current_second,
               alarm_hour, alarm_minute,
               alarm_enabled, alarm_active, alarm_snoozed);

        k_sleep(K_SECONDS(1));
    }
}

// ================================
// Alarm control
// ================================

void alarm_snooze(void)
{
    if (alarm_active) {
        alarm_active        = false;
        alarm_snoozed       = true;
        snooze_seconds_left = SNOOZE_SECONDS;
        active_seconds      = 0;
        printk("Alarm snoozed\n");
    }
}

void alarm_mute(void)
{
    if (alarm_active || alarm_snoozed) {
        alarm_active        = false;
        alarm_snoozed       = false;
        active_seconds      = 0;
        snooze_seconds_left = 0;
        printk("Alarm muted\n");
    }
}

void alarm_toggle_enabled(void)
{
    alarm_enabled = !alarm_enabled;
    if (!alarm_enabled) {
        alarm_active        = false;
        alarm_snoozed       = false;
        active_seconds      = 0;
        snooze_seconds_left = 0;
    }
    printk("Alarm enabled: %d\n", alarm_enabled);
}

// ================================
// LCD text helpers
// ================================

void alarm_get_clock_text(char *buffer, int buffer_size)
{
    snprintf(buffer, buffer_size, "%02d:%02d:%02d",
             current_hour, current_minute, current_second);
}

void alarm_get_status_text(char *buffer, int buffer_size)
{
    if (!alarm_enabled) {
        snprintf(buffer, buffer_size, "                ");
    } else if (alarm_active) {
        snprintf(buffer, buffer_size, "Alarm active");
    } else if (alarm_snoozed) {
        snprintf(buffer, buffer_size, "Alarm snoozed");
    } else {
        snprintf(buffer, buffer_size, "Alarm %02d:%02d", alarm_hour, alarm_minute);
    }
}
```

## src/alarm.h
```c
#ifndef ALARM_H
#define ALARM_H

// ================================
// Alarm thread
// ================================
void alarm_thread_entry(void *arg1, void *arg2, void *arg3);

// ================================
// TODO: kall alarm_snooze() når snooze-knappen trykkes
// TODO: kall alarm_mute() når mute-knappen trykkes
// TODO: kall alarm_toggle_enabled() når enable-knappen trykkes
// ================================

void alarm_get_clock_text(char *buffer, int buffer_size);

void alarm_gpio_init(void);
void alarm_check_buttons(void);

void alarm_snooze(void);
void alarm_mute(void);
void alarm_toggle_enabled(void);
void alarm_get_status_text(char *buffer, int buffer_size);


#endif
```

## src/network_config.c
```c
#include "network_config.h"
#include <zephyr/kernel.h>
#include <zephyr/logging/log.h>
#include <zephyr/net/socket.h>
#include <string.h>
#include <errno.h>

LOG_MODULE_REGISTER(network_config, LOG_LEVEL_INF);

#define HTTP_HOST  "10.130.51.252"
#define HTTP_PORT  5000
#define HTTP_PATH  "/info"

/* =========================
 * SHARED DATA
 * ========================= */

info_data_t g_info = {0};
struct k_mutex info_mutex = Z_MUTEX_INITIALIZER(info_mutex);

/* =========================
 * PARSE INFO
 * ========================= */

static void parse_info(const char *json)
{
	const struct { const char *key; char *dest; } fields[] = {
		{"\"city\":",                g_info.city},
		{"\"country\":",             g_info.country},
		{"\"weather\":",             g_info.weather},
		{"\"temperature_celsius\":", g_info.temperature},
		{"\"latitude\":",            g_info.latitude},
		{"\"longitude\":",           g_info.longitude},
		{"\"unix_epoch\":",          g_info.unix_epoch},
		{NULL, NULL}
	};

	k_mutex_lock(&info_mutex, K_FOREVER);

	for (int i = 0; fields[i].key != NULL; i++) {
		char *pos = strstr(json, fields[i].key);
		if (!pos) continue;
		pos += strlen(fields[i].key);

		while (*pos == ' ' || *pos == '\t') pos++;

		int j = 0;
		if (*pos == '"') {
			pos++;
			while (*pos && *pos != '"' && j < INFO_STR_LEN - 1)
				fields[i].dest[j++] = *pos++;
		} else {
			while (*pos && *pos != ',' && *pos != '}'
			       && *pos != ' ' && j < INFO_STR_LEN - 1)
				fields[i].dest[j++] = *pos++;
		}
		fields[i].dest[j] = '\0';
	}

	g_info.ready = true;
	k_mutex_unlock(&info_mutex);

	LOG_INF("parsed: city='%s' weather='%s' temp='%s' lat='%s' lon='%s' epoch='%s'",
		g_info.city, g_info.weather, g_info.temperature,
		g_info.latitude, g_info.longitude, g_info.unix_epoch);
}

/* =========================
 * HTTP REQUEST
 * ========================= */

static int http_request(const char *path)
{
    LOG_INF("http_request() started: %s", path);

    int sock;
    int ret;

    struct sockaddr_in addr = {0};
    addr.sin_family = AF_INET;
    addr.sin_port   = htons(HTTP_PORT);

    ret = net_addr_pton(AF_INET, HTTP_HOST, &addr.sin_addr);
    if (ret < 0) {
        LOG_ERR("Invalid IP address");
        return -EINVAL;
    }

    sock = socket(AF_INET, SOCK_STREAM, IPPROTO_TCP);
    if (sock < 0) {
        LOG_ERR("Socket creation failed (%d)", errno);
        return -errno;
    }

    ret = connect(sock, (struct sockaddr *)&addr, sizeof(addr));
    if (ret < 0) {
        LOG_ERR("Connect failed (%d)", errno);
        close(sock);
        return -errno;
    }

    LOG_INF("Connected, sending raw HTTP GET");

    char request[256];
    snprintk(request, sizeof(request),
        "GET %s HTTP/1.0\r\n"
        "Host: %s\r\n"
        "Accept: application/json\r\n"
        "Connection: close\r\n"
        "\r\n",
        path, HTTP_HOST);

    ret = send(sock, request, strlen(request), 0);
    if (ret < 0) {
        LOG_ERR("Send failed (%d)", errno);
        close(sock);
        return -errno;
    }

    LOG_INF("Request sent, reading response");

    memset(shared_http_buf, 0, sizeof(shared_http_buf));
    int total = 0;
    int content_length = -1;

    struct zsock_pollfd fds = {
        .fd     = sock,
        .events = ZSOCK_POLLIN,
    };

    while (total < (int)sizeof(shared_http_buf) - 1) {
        int r = zsock_poll(&fds, 1, 8000);
        if (r == 0) {
            LOG_WRN("poll timeout");
            break;
        }
        if (r < 0 && !(fds.revents & ZSOCK_POLLIN)) {
            LOG_WRN("poll error, no data: errno=%d revents=0x%x", errno, fds.revents);
            break;
        }

        int n = recv(sock, shared_http_chunk,
                     sizeof(shared_http_chunk) - 1, 0);
        LOG_INF("recv returned %d", n);
        if (n <= 0) break;
        memcpy(shared_http_buf + total, shared_http_chunk, n);
        total += n;

        if (content_length < 0) {
            char *cl      = strstr((char *)shared_http_buf, "Content-Length: ");
            char *hdr_end = strstr((char *)shared_http_buf, "\r\n\r\n");
            if (cl && hdr_end) {
                content_length = atoi(cl + 16);
                int header_size = (hdr_end + 4) - (char *)shared_http_buf;
                LOG_INF("Content-Length: %d, header: %d", content_length, header_size);
                if (total >= header_size + content_length) break;
            }
        } else {
            char *hdr_end = strstr((char *)shared_http_buf, "\r\n\r\n");
            if (hdr_end) {
                int header_size = (hdr_end + 4) - (char *)shared_http_buf;
                if (total >= header_size + content_length) break;
            }
        }
    }

    LOG_INF("Total bytes received: %d", total);

    char *raw  = (char *)shared_http_buf;
    char *body = strstr(raw, "\r\n\r\n");
    if (body) {
        body += 4;
        LOG_INF("body: %.200s", body);
        parse_info(body);
    } else {
        printk("No body found, raw: %.200s\n", shared_http_buf);
    }

    close(sock);
    return total > 0 ? 0 : -1;
}

/* =========================
 * MAIN NETWORK FUNCTION
 * ========================= */

void network_config(void)
{
    LOG_INF("Waiting for WiFi...");

    if (k_sem_take(&wifi_ready_sem, K_SECONDS(60)) != 0) {
        LOG_ERR("Timed out waiting for WiFi");
        return;
    }

    while (1) {
        LOG_INF("Waiting for HTTP slot...");
        k_mutex_lock(&http_mutex, K_FOREVER);

        LOG_INF("Requesting /info");
        http_request(HTTP_PATH);

        k_mutex_unlock(&http_mutex);

        LOG_INF("Sleeping before next update...");
        k_sleep(K_SECONDS(30));
    }
}

/* =========================
 * THREAD ENTRY
 * ========================= */

void network_config_thread_entry(void *p1, void *p2, void *p3)
{
    printk("=== /info THREAD STARTED ===\n");
    ARG_UNUSED(p1);
    ARG_UNUSED(p2);
    ARG_UNUSED(p3);
    network_config();
}
```

## src/network_config.h
```c
#ifndef BLINKY_NETWORK_CONFIG_H
#define BLINKY_NETWORK_CONFIG_H
#include <zephyr/kernel.h>

extern struct k_sem   wifi_ready_sem;
extern struct k_mutex http_mutex;
extern uint8_t        shared_http_buf[3072];
extern uint8_t        shared_http_chunk[256];

#define INFO_STR_LEN   32
#define NEWS_MAX       10
#define NEWS_TITLE_LEN 80

typedef struct {
	char city[INFO_STR_LEN];
	char country[INFO_STR_LEN];
	char weather[INFO_STR_LEN];
	char temperature[INFO_STR_LEN];
	char latitude[INFO_STR_LEN];
	char longitude[INFO_STR_LEN];
	char unix_epoch[INFO_STR_LEN];
	bool ready;
} info_data_t;

typedef struct {
	char titles[NEWS_MAX][NEWS_TITLE_LEN];
	int  count;
	bool ready;
} news_data_t;

extern info_data_t    g_info;
extern struct k_mutex info_mutex;

extern news_data_t    g_news;
extern struct k_mutex news_mutex;

void wifi_connect(void);
void network_config(void);
void network_config_thread_entry(void *p1, void *p2, void *p3);
void network_config_news(void);
void network_config_thread_entry_news(void *p1, void *p2, void *p3);

#endif // BLINKY_NETWORK_CONFIG_H
```

## src/networking_config_news.c
```c
#include "network_config.h"

#include <zephyr/kernel.h>
#include <zephyr/logging/log.h>
#include <zephyr/net/socket.h>
#include <string.h>
#include <errno.h>

LOG_MODULE_REGISTER(network_config_news, LOG_LEVEL_INF);

#define HTTP_HOST  "10.130.51.252"
#define HTTP_PORT  5000
#define HTTP_PATH  "/news"

/* =========================
 * SHARED NEWS DATA
 * ========================= */

news_data_t    g_news     = {0};
struct k_mutex news_mutex = Z_MUTEX_INITIALIZER(news_mutex);

/* =========================
 * OWN RECEIVE BUFFER
 * Content-Length 3703 + ~186 header = 3889 bytes.
 * 5120 gives comfortable headroom.
 * Static globals — never on the stack.
 * ========================= */

#define NEWS_BUF_SIZE   5120
#define NEWS_CHUNK_SIZE  256

static uint8_t news_buf[NEWS_BUF_SIZE];
static uint8_t news_chunk[NEWS_CHUNK_SIZE];

/* =========================
 * PARSE TITLES
 * ========================= */

static void parse_news_titles(const char *json)
{
    k_mutex_lock(&news_mutex, K_FOREVER);

    g_news.count = 0;
    g_news.ready = false;

    const char *pos = json;

    while (g_news.count < NEWS_MAX) {
        pos = strstr(pos, "\"title\":");
        if (pos == NULL) break;

        pos += 8;
        while (*pos == ' ' || *pos == '\t') pos++;

        if (strncmp(pos, "null", 4) == 0) {
            pos += 4;
            continue;
        }

        if (*pos == '"') pos++;

        int i = 0;
        while (*pos && *pos != '"' && i < NEWS_TITLE_LEN - 1) {
            g_news.titles[g_news.count][i++] = *pos++;
        }
        g_news.titles[g_news.count][i] = '\0';
        if (*pos == '"') pos++;

        if (i > 0) {
            LOG_INF("title %d: %.60s", g_news.count + 1,
                    g_news.titles[g_news.count]);
            g_news.count++;
        }
    }

    if (g_news.count > 0) {
        g_news.ready = true;
    }

    k_mutex_unlock(&news_mutex);

    LOG_INF("Parsed %d news titles", g_news.count);
}

/* =========================
 * HTTP REQUEST
 *
 * KEY DESIGN: http_mutex is held only while connecting and sending.
 * It is released BEFORE the recv loop so the /info thread is never
 * blocked during the slow multi-packet download, which was causing
 * the network stack to drop packets ("Cannot allocate rx packet").
 * ========================= */

static int http_request(const char *path)
{
    LOG_INF("news http_request(): %s", path);

    int sock;
    int ret;

    struct sockaddr_in addr = {0};
    addr.sin_family = AF_INET;
    addr.sin_port   = htons(HTTP_PORT);

    ret = net_addr_pton(AF_INET, HTTP_HOST, &addr.sin_addr);
    if (ret < 0) {
        LOG_ERR("Invalid IP address");
        return -EINVAL;
    }

    /* --- MUTEX ON: connect + send only --- */
    k_mutex_lock(&http_mutex, K_FOREVER);

    sock = socket(AF_INET, SOCK_STREAM, IPPROTO_TCP);
    if (sock < 0) {
        LOG_ERR("Socket creation failed (%d)", errno);
        k_mutex_unlock(&http_mutex);
        return -errno;
    }

    ret = connect(sock, (struct sockaddr *)&addr, sizeof(addr));
    if (ret < 0) {
        LOG_ERR("Connect failed (%d)", errno);
        close(sock);
        k_mutex_unlock(&http_mutex);
        return -errno;
    }

    char request[256];
    snprintk(request, sizeof(request),
        "GET %s HTTP/1.0\r\n"
        "Host: %s\r\n"
        "Accept: application/json\r\n"
        "Connection: close\r\n"
        "\r\n",
        path, HTTP_HOST);

    ret = send(sock, request, strlen(request), 0);
    if (ret < 0) {
        LOG_ERR("Send failed (%d)", errno);
        close(sock);
        k_mutex_unlock(&http_mutex);
        return -errno;
    }

    /* --- MUTEX OFF: release before recv so /info thread can run --- */
    k_mutex_unlock(&http_mutex);

    LOG_INF("Request sent, receiving (mutex released)");

    memset(news_buf, 0, sizeof(news_buf));
    int total          = 0;
    int content_length = -1;

    struct zsock_pollfd fds = {
        .fd     = sock,
        .events = ZSOCK_POLLIN,
    };

    while (total < (int)(sizeof(news_buf) - 1)) {
        int r = zsock_poll(&fds, 1, 8000);
        if (r == 0) {
            LOG_WRN("poll timeout");
            break;
        }
        if (r < 0 && !(fds.revents & ZSOCK_POLLIN)) {
            LOG_WRN("poll error: errno=%d revents=0x%x", errno, fds.revents);
            break;
        }

        int n = recv(sock, news_chunk, sizeof(news_chunk) - 1, 0);
        if (n <= 0) break;

        memcpy(news_buf + total, news_chunk, n);
        total += n;

        if (content_length < 0) {
            char *cl      = strstr((char *)news_buf, "Content-Length: ");
            char *hdr_end = strstr((char *)news_buf, "\r\n\r\n");
            if (cl && hdr_end) {
                content_length = atoi(cl + 16);
                int header_size = (hdr_end + 4) - (char *)news_buf;
                LOG_INF("Content-Length: %d  header: %d bytes",
                        content_length, header_size);
                if (total >= header_size + content_length) break;
            }
        } else {
            char *hdr_end = strstr((char *)news_buf, "\r\n\r\n");
            if (hdr_end) {
                int header_size = (hdr_end + 4) - (char *)news_buf;
                if (total >= header_size + content_length) break;
            }
        }
    }

    LOG_INF("Total bytes received: %d / Content-Length: %d",
            total, content_length);

    char *body = strstr((char *)news_buf, "\r\n\r\n");
    if (body) {
        body += 4;
        parse_news_titles(body);
    } else {
        LOG_WRN("No HTTP body found");
    }

    close(sock);

    /* Success only if we received the full content */
    if (content_length > 0) {
        char *hdr_end  = strstr((char *)news_buf, "\r\n\r\n");
        int   hdr_size = hdr_end ? (hdr_end + 4 - (char *)news_buf) : 0;
        return (total >= hdr_size + content_length) ? 0 : -1;
    }
    return total > 0 ? 0 : -1;
}

/* =========================
 * MAIN NETWORK FUNCTION
 * ========================= */

void network_config_news(void)
{
    LOG_INF("Waiting for WiFi...");

    if (k_sem_take(&wifi_ready_sem, K_SECONDS(60)) != 0) {
        LOG_ERR("Timed out waiting for WiFi");
        return;
    }

    while (1) {
        LOG_INF("Fetching /news");
        int ret = http_request(HTTP_PATH);

        if (ret == 0 && g_news.ready) {
            LOG_INF("News fetched OK (%d titles) — sleeping forever",
                    g_news.count);
            k_sleep(K_FOREVER);
        } else {
            LOG_WRN("News fetch incomplete (got %d titles), retrying in 15 s",
                    g_news.count);
            k_sleep(K_SECONDS(15));
        }
    }
}

/* =========================
 * THREAD ENTRY
 * ========================= */

void network_config_thread_entry_news(void *p1, void *p2, void *p3)
{
    printk("=== /news THREAD STARTED ===\n");
    ARG_UNUSED(p1);
    ARG_UNUSED(p2);
    ARG_UNUSED(p3);
    network_config_news();
}
```

## src/rgb_lcd.c
```c
#include "rgb_lcd.h"

#include <zephyr/kernel.h>
#include <zephyr/device.h>
#include <zephyr/drivers/i2c.h>

// Device I2C address
#define LCD_ADDRESS        (0x7c>>1)

// Payload type
#define LCD_COMMAND        0x80
#define LCD_DATA           0x40

// Commands
#define LCD_CLEARDISPLAY   0x01
#define LCD_RETURNHOME     0x02
#define LCD_ENTRYMODESET   0x04
#define LCD_DISPLAYCONTROL 0x08
#define LCD_CURSORSHIFT    0x10
#define LCD_FUNCTIONSET    0x20
#define LCD_SETCGRAMADDR   0x40
#define LCD_SETDDRAMADDR   0x80

// Flags for display on/off control
#define LCD_DISPLAYON      0x04
#define LCD_DISPLAYOFF     0x00
#define LCD_CURSORON       0x02
#define LCD_CURSOROFF      0x00
#define LCD_BLINKON        0x01
#define LCD_BLINKOFF       0x00

// Flags for function set
#define LCD_8BITMODE       0x10
#define LCD_4BITMODE       0x00
#define LCD_2LINE          0x08
#define LCD_1LINE          0x00
#define LCD_5x10DOTS       0x04
#define LCD_5x8DOTS        0x00

// RGB register addresses
#define REG_MODE1          0x00
#define REG_MODE2          0x01
#define REG_OUTPUT         0x08

// Internal functions

int lcd_function_set(rgb_lcd_1602_t *lcd)
{
    const uint8_t cmd[2] = {LCD_COMMAND, LCD_FUNCTIONSET | LCD_4BITMODE | LCD_2LINE | LCD_5x8DOTS};
    return i2c_write(lcd->dev, cmd, sizeof(cmd), lcd->lcd_addr);
}

int lcd_display_control(const rgb_lcd_1602_t *lcd)
{
    const uint8_t cmd[2] = {LCD_COMMAND, LCD_DISPLAYCONTROL | lcd->control};
    return i2c_write(lcd->dev, cmd, sizeof(cmd), lcd->lcd_addr);
}

int rgb_reg_write(const rgb_lcd_1602_t *lcd, uint8_t reg, uint8_t data)
{
    const uint8_t cmd[2] = {reg, data};
    return i2c_write(lcd->dev, cmd, sizeof(cmd), lcd->rgb_addr);
}

int rgb_init(const rgb_lcd_1602_t *lcd)
{
    if (lcd->rgb_addr == (0xc0 >> 1))
    {
        rgb_reg_write(lcd, REG_MODE1, 0);
        rgb_reg_write(lcd, REG_OUTPUT, 0xFF);
        rgb_reg_write(lcd, REG_MODE2, 0x20);
    } else if (lcd->rgb_addr == (0x60 >> 1))
    {
        rgb_reg_write(lcd, 0x01, 0x00);
        rgb_reg_write(lcd, 0x02, 0xfF);
        rgb_reg_write(lcd, 0x04, 0x15);
    } else if (lcd->rgb_addr == 0x6B)
    {
        rgb_reg_write(lcd, 0x2F, 0x00);
        rgb_reg_write(lcd, 0x00, 0x20);
        rgb_reg_write(lcd, 0x01, 0x00);
        rgb_reg_write(lcd, 0x02, 0x01);
        rgb_reg_write(lcd, 0x03, 4);
    }

    // We're assuming it's fine for now...
    return 0;
}

// Public functions

int rgb_lcd_1602_init(rgb_lcd_1602_t *lcd, const struct device *device, const uint8_t rgb_addr)
{
    if (!device_is_ready(device))
        return -ENODEV;

    lcd->dev = (struct device *) device;

    lcd->cols = 16;
    lcd->rows = 2;

    lcd->control = LCD_DISPLAYON | LCD_CURSOROFF | LCD_BLINKOFF;

    lcd->lcd_addr = LCD_ADDRESS;
    lcd->rgb_addr = rgb_addr;

    if (rgb_addr == (0x60))
    {
        lcd->reg_red = 0x04;
        lcd->reg_green = 0x03;
        lcd->reg_blue = 0x02;
    } else if (rgb_addr == (0x60 >> 1))
    {
        lcd->reg_red = 0x06;
        lcd->reg_green = 0x07;
        lcd->reg_blue = 0x08;
    } else if (rgb_addr == (0x6B))
    {
        lcd->reg_red = 0x06;
        lcd->reg_green = 0x05;
        lcd->reg_blue = 0x04;
    } else if (rgb_addr == (0x2D))
    {
        lcd->reg_red = 0x01;
        lcd->reg_green = 0x02;
        lcd->reg_blue = 0x03;
    }

    // Wait for display to be ready on boot
    k_msleep(50);

    // Send the function set command three times (WHY???)
    for (int i = 0; i < 3; i++)
    {
        lcd_function_set(lcd);
        k_msleep(5);
    }

    lcd_display_control(lcd);
    rgb_lcd_1602_clear(lcd);
    rgb_init(lcd);

    return 0;
}

int rgb_lcd_1602_clear(const rgb_lcd_1602_t *lcd)
{
    const uint8_t cmd[2] = {LCD_COMMAND, LCD_CLEARDISPLAY};
    return i2c_write(lcd->dev, cmd, sizeof(cmd), lcd->lcd_addr);
}

int rgb_lcd_1602_set_cursor(const rgb_lcd_1602_t *lcd, uint8_t col, uint8_t row)
{
    // Row is encoded together with column to one byte
    uint8_t data = (row == 0 ? col | 0x80 : col | 0xc0);

    const uint8_t cmd[2] = {LCD_COMMAND, data};
    return i2c_write(lcd->dev, cmd, sizeof(cmd), lcd->lcd_addr);
}

int rgb_lcd_1602_write_char(const rgb_lcd_1602_t *lcd, uint8_t data)
{
    const uint8_t buf[2] = {LCD_DATA, data};
    return i2c_write(lcd->dev, buf, sizeof(buf), lcd->lcd_addr);
}

int rgb_lcd_1602_set_rgb(const rgb_lcd_1602_t *lcd, uint8_t r, uint8_t g, uint8_t b)
{
    uint8_t buf[2];
    int ret;

    buf[0] = lcd->reg_red;
    buf[1] = r;
    ret = i2c_write(lcd->dev, buf, 2, lcd->rgb_addr);
    if (ret) return ret;

    buf[0] = lcd->reg_green;
    buf[1] = g;
    ret = i2c_write(lcd->dev, buf, 2, lcd->rgb_addr);
    if (ret) return ret;

    buf[0] = lcd->reg_blue;
    buf[1] = b;
    return i2c_write(lcd->dev, buf, 2, lcd->rgb_addr);
}
```

## src/rgb_lcd.h
```c
//
// Created by luna on 4/22/26.
//

#ifndef BLINKY_RGB_LCD_H
#define BLINKY_RGB_LCD_H

#include <zephyr/device.h>
#include <stdint.h>

typedef struct
{
	uint8_t cols;
	uint8_t rows;

	uint8_t lcd_addr;
	uint8_t rgb_addr;

	uint8_t reg_red;
	uint8_t reg_green;
	uint8_t reg_blue;

	uint8_t control;

	struct device *dev;
} rgb_lcd_1602_t;


int rgb_lcd_1602_init(rgb_lcd_1602_t *lcd, const struct device *device, uint8_t rgb_addr);

int rgb_lcd_1602_clear(const rgb_lcd_1602_t *lcd);
int rgb_lcd_1602_set_cursor(const rgb_lcd_1602_t *lcd, uint8_t col, uint8_t row);
int rgb_lcd_1602_write_char(const rgb_lcd_1602_t *lcd, uint8_t data);

int rgb_lcd_1602_set_rgb(const rgb_lcd_1602_t *lcd, uint8_t r, uint8_t g, uint8_t b);

#endif //BLINKY_RGB_LCD_H
```

## src/screen.c
```c
#include "rgb_lcd.h"
#include "screen.h"
#include "alarm.h"
#include "tem_hum.h"
#include "network_config.h"
#include <zephyr/kernel.h>
#include <zephyr/sys/printk.h>
#include <string.h>
#include <stdio.h>

static rgb_lcd_1602_t lcd;

/* Timeout for all info/news mutex locks — never block forever from the
   screen thread, so a stuck network thread cannot freeze the display. */
#define MUTEX_TIMEOUT_MS  200

// ================================
// LCD helper: write string
// ================================
static void lcd_write_string(const char *text)
{
    if (text == NULL) return;
    k_usleep(500);
    for (int i = 0; i < (int)strlen(text) && i < 16; i++) {
        rgb_lcd_1602_write_char(&lcd, text[i]);
        k_msleep(2);
    }
}

// ================================
// LCD helper: write two lines
// ================================
static void lcd_show(const char *line1, const char *line2)
{
    rgb_lcd_1602_clear(&lcd);
    k_msleep(5);
    rgb_lcd_1602_set_cursor(&lcd, 0, 0);
    lcd_write_string(line1);
    rgb_lcd_1602_set_cursor(&lcd, 0, 1);
    lcd_write_string(line2);
}

// ================================
// Boot screen
// ================================
void boot(void)
{
    const struct device *i2c1 = DEVICE_DT_GET(DT_NODELABEL(i2c1));

    if (!device_is_ready(i2c1)) {
        printk("I2C device not ready\n");
        return;
    }

    if (rgb_lcd_1602_init(&lcd, i2c1, 0x2D) != 0) {
        printk("rgb_lcd1602_init() failed\n");
        return;
    }

    rgb_lcd_1602_set_rgb(&lcd, 255, 0, 255);
    rgb_lcd_1602_clear(&lcd);
    k_msleep(10);

    rgb_lcd_1602_set_cursor(&lcd, 0, 0);
    lcd_write_string("System Loading");
    rgb_lcd_1602_set_cursor(&lcd, 0, 1);
    lcd_write_string("Please wait...");

    k_sleep(K_SECONDS(2));
}

// ================================
// Screen: alarm (clock + status)
// ================================
void screen_show_alarm(void)
{
    char line1[17] = {0};
    char line2[17] = {0};
    alarm_get_clock_text(line1, sizeof(line1));
    alarm_get_status_text(line2, sizeof(line2));
    lcd_show(line1, line2);
}

// ================================
// Screen: temperature and humidity
// ================================
void screen_show_temp_hum(void)
{
    char line1[17] = {0};
    char line2[17] = {0};

    float temp = (float)tem_hum_get_temp();
    float hum  = (float)tem_hum_get_hum();

    int temp_int = (int)temp;
    int temp_dec = (int)(temp * 10.0f) % 10;
    if (temp_dec < 0) temp_dec = -temp_dec;

    snprintf(line1, sizeof(line1), "Temp:  %d.%d C", temp_int, temp_dec);
    snprintf(line2, sizeof(line2), "Humid: %d%%", (int)hum);

    lcd_show(line1, line2);
}

/* --------------------------------
 * Safe info snapshot helper.
 * Tries to lock info_mutex with a timeout; on failure returns false
 * and the caller shows "No data yet" without hanging.
 * -------------------------------- */
static bool get_info_snapshot(info_data_t *out)
{
    if (k_mutex_lock(&info_mutex, K_MSEC(MUTEX_TIMEOUT_MS)) != 0) {
        return false;
    }
    *out = g_info;   /* struct copy under the lock */
    k_mutex_unlock(&info_mutex);
    return true;
}

// ================================
// Screen: weather
// ================================
static void screen_show_weather(void)
{
    info_data_t info = {0};
    if (!get_info_snapshot(&info) || info.weather[0] == '\0') {
        lcd_show("Weather:", "No data yet");
        return;
    }
    char line2[17] = {0};
    snprintf(line2, sizeof(line2), "%.13s C", info.temperature);
    lcd_show(info.weather, line2);
}

// ================================
// Screen: Unix epoch
// ================================
static void screen_show_epoch(void)
{
    info_data_t info = {0};
    if (!get_info_snapshot(&info) || info.unix_epoch[0] == '\0') {
        lcd_show("Unix epoch:", "No data yet");
        return;
    }
    lcd_show("Unix epoch:", info.unix_epoch);
}

// ================================
// Screen: latitude and longitude
// ================================
static void screen_show_latlon(void)
{
    info_data_t info = {0};
    if (!get_info_snapshot(&info) || info.latitude[0] == '\0') {
        lcd_show("Lat/Lon:", "No data yet");
        return;
    }
    char line1[17] = {0};
    char line2[17] = {0};
    snprintf(line1, sizeof(line1), "Lat: %.11s", info.latitude);
    snprintf(line2, sizeof(line2), "Lon: %.11s", info.longitude);
    lcd_show(line1, line2);
}

// ================================
// Screen: city
// ================================
static void screen_show_city(void)
{
    info_data_t info = {0};
    if (!get_info_snapshot(&info) || info.city[0] == '\0') {
        lcd_show("City:", "No data yet");
        return;
    }
    lcd_show("City:", info.city);
}

// ================================
// Unix epoch → calendar
// ================================

static const char *weekday_name(int wd)
{
    static const char *days[] = {
        "Sunday", "Monday", "Tuesday",
        "Wednesday", "Thursday", "Friday", "Saturday"
    };
    if (wd < 0 || wd > 6) return "???";
    return days[wd];
}

static const char *month_name(int m)
{
    static const char *months[] = {
        "", "Jan", "Feb", "Mar", "Apr", "May", "Jun",
        "Jul", "Aug", "Sep", "Oct", "Nov", "Dec"
    };
    if (m < 1 || m > 12) return "???";
    return months[m];
}

static void epoch_to_datetime(long epoch,
                               int *year, int *month, int *day,
                               int *hour, int *min,  int *sec,
                               int *wday)
{
    if (epoch < 0) epoch = 0;

    *sec  = (int)(epoch % 60);
    *min  = (int)((epoch / 60) % 60);
    *hour = (int)((epoch / 3600) % 24);

    long days_total = epoch / 86400L;
    *wday = (int)((days_total + 4) % 7);

    long d = days_total;
    *year  = 1970;
    while (*year < 2100) {
        int leap = ((*year % 4 == 0 && *year % 100 != 0) ||
                    (*year % 400 == 0));
        int days_in_year = leap ? 366 : 365;
        if (d < (long)days_in_year) break;
        d -= days_in_year;
        (*year)++;
    }

    static const int mdays[13] = {0,31,28,31,30,31,30,31,31,30,31,30,31};
    int leap = ((*year % 4 == 0 && *year % 100 != 0) ||
                (*year % 400 == 0));
    for (*month = 1; *month <= 12; (*month)++) {
        int md = mdays[*month] + (*month == 2 && leap ? 1 : 0);
        if (d < (long)md) break;
        d -= md;
    }
    if (*month > 12) *month = 12;
    *day = (int)d + 1;
}

// ================================
// Screen: date + time
// ================================
static void screen_show_datetime(void)
{
    info_data_t info = {0};
    if (!get_info_snapshot(&info) || info.unix_epoch[0] == '\0') {
        char line1[17] = {0};
        alarm_get_clock_text(line1, sizeof(line1));
        lcd_show(line1, "No date yet");
        return;
    }

    long epoch = 0;
    for (int i = 0; info.unix_epoch[i] >= '0' && info.unix_epoch[i] <= '9'; i++) {
        epoch = epoch * 10 + (long)(info.unix_epoch[i] - '0');
    }

    int year, month, day, hour, min, sec, wday;
    epoch_to_datetime(epoch, &year, &month, &day, &hour, &min, &sec, &wday);

    char line1[17] = {0};
    char line2[17] = {0};
    snprintf(line1, sizeof(line1), "%.3s %d %s",
             weekday_name(wday), day, month_name(month));
    snprintf(line2, sizeof(line2), "%02d:%02d:%02d", hour, min, sec);
    lcd_show(line1, line2);
}

// ================================
// Screen: news titles
// ================================

/* Static so the 10*80 = 800-byte snapshot never sits on the stack */
static char news_snapshot[NEWS_MAX][NEWS_TITLE_LEN];

static void screen_show_news(void)
{
    int count = 0;

    if (k_mutex_lock(&news_mutex, K_MSEC(MUTEX_TIMEOUT_MS)) == 0) {
        if (g_news.ready) {
            count = g_news.count;
            for (int i = 0; i < count; i++) {
                strncpy(news_snapshot[i], g_news.titles[i], NEWS_TITLE_LEN - 1);
                news_snapshot[i][NEWS_TITLE_LEN - 1] = '\0';
            }
        }
        k_mutex_unlock(&news_mutex);
    }

    if (count == 0) {
        lcd_show("News:", "No data yet");
        k_sleep(K_SECONDS(2));
        return;
    }

    for (int i = 0; i < count; i++) {
        char line1[17] = {0};
        char line2[17] = {0};

        snprintf(line1, sizeof(line1), "News %d/%d", i + 1, count);
        snprintf(line2, sizeof(line2), "%.16s", news_snapshot[i]);
        lcd_show(line1, line2);
        k_sleep(K_SECONDS(3));

        if ((int)strlen(news_snapshot[i]) > 16) {
            snprintf(line2, sizeof(line2), "%.16s", news_snapshot[i] + 16);
            lcd_show(line1, line2);
            k_sleep(K_SECONDS(2));
        }
    }
}

// ================================
// Main Thread Entry
// ================================
void screen_thread_entry(void *arg1, void *arg2, void *arg3)
{
    ARG_UNUSED(arg1);
    ARG_UNUSED(arg2);
    ARG_UNUSED(arg3);

    boot();

    while (1) {
        screen_show_alarm();
        k_sleep(K_SECONDS(2));

        screen_show_temp_hum();
        k_sleep(K_SECONDS(2));

        // screen_show_news();

        screen_show_weather();
        k_sleep(K_SECONDS(2));

        screen_show_epoch();
        k_sleep(K_SECONDS(2));

        screen_show_latlon();
        k_sleep(K_SECONDS(2));

        screen_show_city();
        k_sleep(K_SECONDS(2));

        screen_show_datetime();
        k_sleep(K_SECONDS(2));
    }
}
```

## src/screen.h
```c
#ifndef SCREEN_H
#define SCREEN_H

void boot(void);
void screen_show_alarm(void);
void screen_show_temp_hum(void);
void screen_thread_entry(void *arg1, void *arg2, void *arg3);

#endif // SCREEN_H
```

## src/tem_hum.c
```c
#include "tem_hum.h"

#include <stdbool.h>

#include <zephyr/device.h>
#include <zephyr/drivers/sensor.h>
#include <zephyr/sys/printk.h>

// ================================
// Global sensor variables
// ================================

static const struct device *sensor;

static double temperature = 0.0;
static double humidity = 0.0;

// ================================
// Initialize sensor
// ================================

void tem_hum_init(void)
{
	sensor = DEVICE_DT_GET_ANY(st_hts221);

	if (sensor == NULL) {
		printk("HTS221 sensor not found\n");
		return;
	}

	if (!device_is_ready(sensor)) {
		printk("HTS221 sensor not ready\n");
		return;
	}

	printk("HTS221 sensor ready\n");
}

// ================================
// Read temperature and humidity
// ================================

void tem_hum_update(void)
{
	struct sensor_value temp;
	struct sensor_value hum;

	if (!device_is_ready(sensor)) {
		printk("Sensor not ready\n");
		return;
	}

	sensor_sample_fetch(sensor);

	sensor_channel_get(sensor, SENSOR_CHAN_AMBIENT_TEMP, &temp);
	sensor_channel_get(sensor, SENSOR_CHAN_HUMIDITY, &hum);

	temperature = sensor_value_to_double(&temp);
	humidity = sensor_value_to_double(&hum);

	printk("Temp: %d.%d C | Humidity: %d.%d %%\n",
	    (int)temperature,
	    (int)(temperature * 10) % 10,
	    (int)humidity,
	    (int)(humidity * 10) % 10);
}

// ================================
// Get latest temperature
// ================================

double tem_hum_get_temp(void)
{
	return temperature;
}

// ================================
// Get latest humidity
// ================================

double tem_hum_get_hum(void)
{
	return humidity;
}
```

## src/tem_hum.h
```c
#ifndef BLINKY_TEM_HUM_H
#define BLINKY_TEM_HUM_H

// ================================
// Temp / humidity functions
// ================================

void tem_hum_init(void);
void tem_hum_update(void);

double tem_hum_get_temp(void);
double tem_hum_get_hum(void);

#endif
```

## src/wifi_connect.c
```c
#define WIFI_SSID     "JLV-21-23"
#define WIFI_PASSWORD "1522221300"

#include "network_config.h"

#include <zephyr/kernel.h>
#include <zephyr/logging/log.h>
#include <zephyr/net/net_if.h>
#include <zephyr/net/net_mgmt.h>
#include <zephyr/net/wifi_mgmt.h>

K_MUTEX_DEFINE(http_mutex);

LOG_MODULE_REGISTER(wifi_connect, LOG_LEVEL_INF);

// This semaphore is shared with both network files
K_SEM_DEFINE(wifi_ready_sem, 0, 1);
uint8_t shared_http_buf[3072];
uint8_t shared_http_chunk[256];

static bool ip_handled = false;

static void event_handler(uint64_t mgmt_event,
                          struct net_if *iface,
                          void *info,
                          size_t info_length,
                          void *user_data)
{
    switch (mgmt_event) {

    case NET_EVENT_WIFI_CONNECT_RESULT: {
        const struct wifi_status *status = (const struct wifi_status *)info;
        if (status->status) {
            LOG_ERR("WiFi connection failed (%d)", status->status);
        } else {
            LOG_INF("Connected to WiFi");
        }
        break;
    }

    case NET_EVENT_IPV4_ADDR_ADD:
        if (!ip_handled) {
            ip_handled = true;
            LOG_INF("Got IPv4 address");
            k_sem_give(&wifi_ready_sem);
        }
        break;

    default:
        break;
    }
}

NET_MGMT_REGISTER_EVENT_HANDLER(
    wifi_handler,
    NET_EVENT_WIFI_CONNECT_RESULT,
    event_handler,
    NULL
);

NET_MGMT_REGISTER_EVENT_HANDLER(
    ipv4_handler,
    NET_EVENT_IPV4_ADDR_ADD,
    event_handler,
    NULL
);

void wifi_connect(void)
{
    LOG_INF("Waiting 5 seconds for networking stack");
    k_sleep(K_SECONDS(5));

    struct net_if *iface = net_if_get_default();
    if (!iface) {
        LOG_ERR("No network interface found");
        return;
    }

    static struct wifi_connect_req_params params = {
        .ssid        = WIFI_SSID,
        .ssid_length = sizeof(WIFI_SSID) - 1,
        .psk         = WIFI_PASSWORD,
        .psk_length  = sizeof(WIFI_PASSWORD) - 1,
        .channel     = WIFI_CHANNEL_ANY,
        .security    = WIFI_SECURITY_TYPE_PSK,
        .band        = WIFI_FREQ_BAND_2_4_GHZ,
    };

    LOG_INF("Connecting to WiFi: %s", WIFI_SSID);

    int ret = net_mgmt(NET_REQUEST_WIFI_CONNECT, iface, &params, sizeof(params));
    if (ret) {
        LOG_ERR("WiFi connect request failed (%d)", ret);
        return;
    }

    LOG_INF("Waiting for IP address...");
    if (k_sem_take(&wifi_ready_sem, K_SECONDS(30)) != 0) {
        LOG_ERR("Timeout waiting for IP address");
        return;
    }

    LOG_INF("WiFi ready - giving semaphore to both network threads");

    // Release twice so both waiting threads can proceed
    k_sem_give(&wifi_ready_sem);
    k_sem_give(&wifi_ready_sem);
}
```
