## exsamene/build/Kconfig/arch/Kconfig
```kconfig
# Load Zephyr Arch Kconfig descriptions.
osource "/home/luna/ikt104g26v/zephyr/arch/rx/Kconfig"
osource "/home/luna/ikt104g26v/zephyr/arch/x86/Kconfig"
osource "/home/luna/ikt104g26v/zephyr/arch/xtensa/Kconfig"
osource "/home/luna/ikt104g26v/zephyr/arch/sparc/Kconfig"
osource "/home/luna/ikt104g26v/zephyr/arch/riscv/Kconfig"
osource "/home/luna/ikt104g26v/zephyr/arch/posix/Kconfig"
osource "/home/luna/ikt104g26v/zephyr/arch/mips/Kconfig"
osource "/home/luna/ikt104g26v/zephyr/arch/arm64/Kconfig"
osource "/home/luna/ikt104g26v/zephyr/arch/arm/Kconfig"
osource "/home/luna/ikt104g26v/zephyr/arch/arc/Kconfig"
```

## exsamene/build/Kconfig/boards/Kconfig.defconfig
```kconfig
# Load Zephyr board defconfig descriptions.
osource "/home/luna/ikt104g26v/zephyr/boards/st/disco_l475_iot1/Kconfig.defconfig"
```

## exsamene/build/Kconfig/boards/Kconfig.disco_l475_iot1
```kconfig
# Load board Kconfig descriptions.
osource "/home/luna/ikt104g26v/zephyr/boards/st/disco_l475_iot1/Kconfig.disco_l475_iot1"
```

## exsamene/build/Kconfig/boards/Kconfig.sysbuild
```kconfig
# Load Sysbuild board Kconfig descriptions.
osource "/home/luna/ikt104g26v/zephyr/boards/st/disco_l475_iot1/Kconfig.sysbuild"
```

## exsamene/build/Kconfig/soc/Kconfig
```kconfig
# Load Zephyr SoC Kconfig descriptions.
osource "/home/luna/ikt104g26v/zephyr/soc/xlnx/zynqmp/Kconfig"
osource "/home/luna/ikt104g26v/zephyr/soc/xlnx/zynq7000/Kconfig"
osource "/home/luna/ikt104g26v/zephyr/soc/xlnx/versalnet/Kconfig"
osource "/home/luna/ikt104g26v/zephyr/soc/xlnx/versal2/Kconfig"
osource "/home/luna/ikt104g26v/zephyr/soc/xen/Kconfig"
osource "/home/luna/ikt104g26v/zephyr/soc/wch/ch32v/Kconfig"
osource "/home/luna/ikt104g26v/zephyr/soc/ti/simplelink/Kconfig"
osource "/home/luna/ikt104g26v/zephyr/soc/ti/mspm0/Kconfig"
osource "/home/luna/ikt104g26v/zephyr/soc/ti/lm3s6965/Kconfig"
osource "/home/luna/ikt104g26v/zephyr/soc/ti/k3/Kconfig"
osource "/home/luna/ikt104g26v/zephyr/soc/telink/tlsr/Kconfig"
osource "/home/luna/ikt104g26v/zephyr/soc/starfive/jh71xx/Kconfig"
osource "/home/luna/ikt104g26v/zephyr/soc/st/stm32/Kconfig"
osource "/home/luna/ikt104g26v/zephyr/soc/snps/qemu_arc/Kconfig"
osource "/home/luna/ikt104g26v/zephyr/soc/snps/nsim/arc_v/Kconfig"
osource "/home/luna/ikt104g26v/zephyr/soc/snps/nsim/arc_classic/Kconfig"
osource "/home/luna/ikt104g26v/zephyr/soc/snps/hsdk4xd/Kconfig"
osource "/home/luna/ikt104g26v/zephyr/soc/snps/hsdk/Kconfig"
osource "/home/luna/ikt104g26v/zephyr/soc/snps/emsk/Kconfig"
osource "/home/luna/ikt104g26v/zephyr/soc/snps/emsdp/Kconfig"
osource "/home/luna/ikt104g26v/zephyr/soc/snps/arc_iot/Kconfig"
osource "/home/luna/ikt104g26v/zephyr/soc/silabs/Kconfig"
osource "/home/luna/ikt104g26v/zephyr/soc/sifli/sf32/Kconfig"
osource "/home/luna/ikt104g26v/zephyr/soc/sifive/sifive_freedom/Kconfig"
osource "/home/luna/ikt104g26v/zephyr/soc/sensry/Kconfig"
osource "/home/luna/ikt104g26v/zephyr/soc/rockchip/Kconfig"
osource "/home/luna/ikt104g26v/zephyr/soc/renode/riscv_virtual/Kconfig"
osource "/home/luna/ikt104g26v/zephyr/soc/renode/cortex_r8_virtual/Kconfig"
osource "/home/luna/ikt104g26v/zephyr/soc/renesas/smartbond/Kconfig"
osource "/home/luna/ikt104g26v/zephyr/soc/renesas/rz/Kconfig"
osource "/home/luna/ikt104g26v/zephyr/soc/renesas/rx/Kconfig"
osource "/home/luna/ikt104g26v/zephyr/soc/renesas/rcar/Kconfig"
osource "/home/luna/ikt104g26v/zephyr/soc/renesas/ra/Kconfig"
osource "/home/luna/ikt104g26v/zephyr/soc/realtek/ec/Kconfig"
osource "/home/luna/ikt104g26v/zephyr/soc/raspberrypi/rpi_pico/Kconfig"
osource "/home/luna/ikt104g26v/zephyr/soc/quicklogic/eos_s3/Kconfig"
osource "/home/luna/ikt104g26v/zephyr/soc/qemu/virt_riscv/Kconfig"
osource "/home/luna/ikt104g26v/zephyr/soc/qemu/malta/Kconfig"
osource "/home/luna/ikt104g26v/zephyr/soc/openisa/rv32m1/Kconfig"
osource "/home/luna/ikt104g26v/zephyr/soc/openhwgroup/cva6/Kconfig"
osource "/home/luna/ikt104g26v/zephyr/soc/oct/osd32mp15x/Kconfig"
osource "/home/luna/ikt104g26v/zephyr/soc/nxp/s32/Kconfig"
osource "/home/luna/ikt104g26v/zephyr/soc/nxp/rw/Kconfig"
osource "/home/luna/ikt104g26v/zephyr/soc/nxp/mcx/Kconfig"
osource "/home/luna/ikt104g26v/zephyr/soc/nxp/lpc/Kconfig"
osource "/home/luna/ikt104g26v/zephyr/soc/nxp/layerscape/Kconfig"
osource "/home/luna/ikt104g26v/zephyr/soc/nxp/kinetis/Kconfig"
osource "/home/luna/ikt104g26v/zephyr/soc/nxp/imxrt/Kconfig"
osource "/home/luna/ikt104g26v/zephyr/soc/nxp/imx/Kconfig"
osource "/home/luna/ikt104g26v/zephyr/soc/nuvoton/numicro/Kconfig"
osource "/home/luna/ikt104g26v/zephyr/soc/nuvoton/numaker/Kconfig"
osource "/home/luna/ikt104g26v/zephyr/soc/nuvoton/npcx/Kconfig"
osource "/home/luna/ikt104g26v/zephyr/soc/nuvoton/npcm/Kconfig"
osource "/home/luna/ikt104g26v/zephyr/soc/nordic/Kconfig"
osource "/home/luna/ikt104g26v/zephyr/soc/neorv32/Kconfig"
osource "/home/luna/ikt104g26v/zephyr/soc/native/inf_clock/Kconfig"
osource "/home/luna/ikt104g26v/zephyr/soc/microchip/sam/Kconfig"
osource "/home/luna/ikt104g26v/zephyr/soc/microchip/sam/sama7/Kconfig"
osource "/home/luna/ikt104g26v/zephyr/soc/microchip/sam/sam_d5x_e5x/Kconfig"
osource "/home/luna/ikt104g26v/zephyr/soc/microchip/pic32c/pic32cz_ca/Kconfig"
osource "/home/luna/ikt104g26v/zephyr/soc/microchip/pic32c/pic32cx_sg/Kconfig"
osource "/home/luna/ikt104g26v/zephyr/soc/microchip/pic32c/pic32cm_jh/Kconfig"
osource "/home/luna/ikt104g26v/zephyr/soc/microchip/miv/Kconfig"
osource "/home/luna/ikt104g26v/zephyr/soc/microchip/mec/Kconfig"
osource "/home/luna/ikt104g26v/zephyr/soc/mediatek/mt8xxx/Kconfig"
osource "/home/luna/ikt104g26v/zephyr/soc/lowrisc/opentitan/Kconfig"
osource "/home/luna/ikt104g26v/zephyr/soc/litex/litex_vexriscv/Kconfig"
osource "/home/luna/ikt104g26v/zephyr/soc/ite/ec/Kconfig"
osource "/home/luna/ikt104g26v/zephyr/soc/intel/raptor_lake/Kconfig"
osource "/home/luna/ikt104g26v/zephyr/soc/intel/panther_lake/Kconfig"
osource "/home/luna/ikt104g26v/zephyr/soc/intel/lakemont/Kconfig"
osource "/home/luna/ikt104g26v/zephyr/soc/intel/intel_socfpga_std/Kconfig"
osource "/home/luna/ikt104g26v/zephyr/soc/intel/intel_socfpga/Kconfig"
osource "/home/luna/ikt104g26v/zephyr/soc/intel/intel_niosv/Kconfig"
osource "/home/luna/ikt104g26v/zephyr/soc/intel/intel_ish/Kconfig"
osource "/home/luna/ikt104g26v/zephyr/soc/intel/intel_adsp/Kconfig"
osource "/home/luna/ikt104g26v/zephyr/soc/intel/elkhart_lake/Kconfig"
osource "/home/luna/ikt104g26v/zephyr/soc/intel/atom/Kconfig"
osource "/home/luna/ikt104g26v/zephyr/soc/intel/apollo_lake/Kconfig"
osource "/home/luna/ikt104g26v/zephyr/soc/intel/alder_lake/Kconfig"
osource "/home/luna/ikt104g26v/zephyr/soc/infineon/edge/Kconfig"
osource "/home/luna/ikt104g26v/zephyr/soc/infineon/cat3/Kconfig"
osource "/home/luna/ikt104g26v/zephyr/soc/infineon/cat1c/Kconfig"
osource "/home/luna/ikt104g26v/zephyr/soc/infineon/cat1b/Kconfig"
osource "/home/luna/ikt104g26v/zephyr/soc/infineon/cat1a/Kconfig"
osource "/home/luna/ikt104g26v/zephyr/soc/gd/gd32/Kconfig"
osource "/home/luna/ikt104g26v/zephyr/soc/gaisler/leon3/Kconfig"
osource "/home/luna/ikt104g26v/zephyr/soc/gaisler/gr716a/Kconfig"
osource "/home/luna/ikt104g26v/zephyr/soc/espressif/Kconfig"
osource "/home/luna/ikt104g26v/zephyr/soc/ene/kb1200/Kconfig"
osource "/home/luna/ikt104g26v/zephyr/soc/ene/kb106x/Kconfig"
osource "/home/luna/ikt104g26v/zephyr/soc/egis/Kconfig"
osource "/home/luna/ikt104g26v/zephyr/soc/efinix/sapphire/Kconfig"
osource "/home/luna/ikt104g26v/zephyr/soc/cdns/xtensa_sample_controller/Kconfig"
osource "/home/luna/ikt104g26v/zephyr/soc/cdns/sample_controller32/Kconfig"
osource "/home/luna/ikt104g26v/zephyr/soc/cdns/dc233c/Kconfig"
osource "/home/luna/ikt104g26v/zephyr/soc/brcm/bcmvk/Kconfig"
osource "/home/luna/ikt104g26v/zephyr/soc/brcm/bcm2712/Kconfig"
osource "/home/luna/ikt104g26v/zephyr/soc/brcm/bcm2711/Kconfig"
osource "/home/luna/ikt104g26v/zephyr/soc/bflb/Kconfig"
osource "/home/luna/ikt104g26v/zephyr/soc/atmel/sam0/Kconfig"
osource "/home/luna/ikt104g26v/zephyr/soc/atmel/sam/Kconfig"
osource "/home/luna/ikt104g26v/zephyr/soc/aspeed/Kconfig"
osource "/home/luna/ikt104g26v/zephyr/soc/arm/Kconfig"
osource "/home/luna/ikt104g26v/zephyr/soc/arm/beetle/Kconfig"
osource "/home/luna/ikt104g26v/zephyr/soc/antmicro/myra/Kconfig"
osource "/home/luna/ikt104g26v/zephyr/soc/andestech/Kconfig"
osource "/home/luna/ikt104g26v/zephyr/soc/amd/acp_6_0/Kconfig"
osource "/home/luna/ikt104g26v/zephyr/soc/ambiq/Kconfig"
osource "/home/luna/ikt104g26v/zephyr/soc/aesc/Kconfig"
osource "/home/luna/ikt104g26v/zephyr/soc/adi/max32/Kconfig"
```
